## drivers/staging/psb/Kconfig
```kconfig
config DRM_PSB
	tristate "Intel Poulsbo/Moorestown DRM support"
	depends on DRM && PCI
	select FB_CFB_COPYAREA
	select FB_CFB_FILLRECT
	select FB_CFB_IMAGEBLIT
	help
	  Choose this option if you have a Poulsbo or Moorestown platform.
	  If M is selected the module will be called psb.
```

## drivers/staging/rtl8192u/Kconfig
```kconfig
config RTL8192U
	tristate "RealTek RTL8192U Wireless LAN NIC driver"
	depends on PCI && WLAN && USB && WIRELESS_EXT
	select WEXT_PRIV
	select CRYPTO
	default N
	---help---
```

## jolicloud/Kconfig
```kconfig
menu "Jolicloud Supplied Third-Party Device Drivers"

source "jolicloud/asus_eee/Kconfig"
source "jolicloud/broadcom/Kconfig"
source "jolicloud/psb/Kconfig"
source "jolicloud/nvidia/Kconfig"
source "jolicloud/via_chrome9/Kconfig"
source "jolicloud/rt3090/Kconfig"
source "jolicloud/rtl8192ce/Kconfig"
source "jolicloud/rtl8192se/Kconfig"

endmenu
```

## jolicloud/asus_eee/Kconfig
```kconfig
config ASUS_EEE
	tristate "ASUS_EEE FSB support (EXPERIMENTAL)"
	depends on I2C_I801 && EXPERIMENTAL
	help
	  This driver supports the Asus EEE FSB overclocking module.

	  To compile this driver as a module, choose M here.  The module
	  will be called asus_eee.
```

## jolicloud/netbook/Kconfig
```kconfig
config NETBOOK
	tristate "Netbook FSB driver"
	depends on I2C_I801 && PCI && X86
	default m
```

## jolicloud/nvidia/Kconfig
```kconfig
config DRM_NVIDIA
	tristate "NVIDIA"
	depends on DRM && PCI && !FB_RIVA && !FB_NVIDIA
	help
	  Choose
```

## jolicloud/rtl8192ce/Kconfig
```kconfig
config RTL8192CE
	tristate "RealTek RTL8192CE Wireless LAN NIC driver"
	depends on PCI && WLAN
	depends on WIRELESS_EXT
	default N
	---help---
```

## jolicloud/rtl8192se/Kconfig
```kconfig
config RTL8192SE
	tristate "RealTek RTL8192SE Wireless LAN NIC driver"
	depends on PCI && WLAN
	depends on WIRELESS_EXT
	default N
	---help---
```

## jolicloud/via_chrome9/Kconfig
```kconfig
config DRM_VIA_CHROME9
	tristate "Via chrome9 video cards"
	depends on DRM
	help
	  Choose this option if you have a Via chrome9 or compatible video
	  chipset. If M is selected the module will be called via_chrome9.
```

## ubuntu/Kconfig
```kconfig
menu "Ubuntu Supplied Third-Party Device Drivers"

source "ubuntu/aufs/Kconfig"
source "ubuntu/compcache/Kconfig"

endmenu
```
